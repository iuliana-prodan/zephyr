## boards/xtensa/nxp_adsp_imx8ulp/Kconfig.defconfig
```kconfig
# Copyright (c) 2023 NXP
# SPDX-License-Identifier: Apache-2.0

if BOARD_NXP_ADSP_IMX8ULP

config BOARD
	default "nxp_adsp_imx8ulp"

config DUMMY_DMA
	bool
	default y
	depends on DMA

config IMX_EDMA
	bool
	default y
	depends on DMA

endif # BOARD_NXP_ADSP_IMX8ULP
```

## boards/xtensa/nxp_adsp_imx8ulp/nxp_adsp_imx8ulp_defconfig
```kconfig
# SPDX-License-Identifier: Apache-2.0
CONFIG_SOC_SERIES_NXP_IMX8ULP=y
CONFIG_SOC_NXP_IMX8ULP=y
CONFIG_BOARD_NXP_ADSP_IMX8ULP=y

CONFIG_GEN_ISR_TABLES=y
CONFIG_GEN_IRQ_VECTOR_TABLE=n
CONFIG_XTENSA_SMALL_VECTOR_TABLE_ENTRY=y
```

## dts/bindings/misc/zephyr,addr-translation.yaml
```yaml
# Copyright 2025 NXP
# SPDX-License-Identifier: Apache-2.0

description: Address translation support for OpenAMP

compatible: "zephyr,addr-translation"

include: base.yaml

properties:
  ranges:
    type: array
    required: true
    description: |
      Driver and device adresses.
  dma-ranges:
    type: array
    required: true
    description: |
      Driver and device adresses.
  reg:
    required: true
```

## soc/xtensa/nxp_adsp/imx8ulp/Kconfig.defconfig.series
```kconfig
# Copyright (c) 2023 NXP
# SPDX-License-Identifier: Apache-2.0

if SOC_SERIES_NXP_IMX8ULP

config SOC_SERIES
	string
	default "IMX8ULP"

config SOC_TOOLCHAIN_NAME
	string
	default "nxp_imx8ulp_adsp"

config SOC
	string
	default "nxp_imx8ulp"

config SYS_CLOCK_HW_CYCLES_PER_SEC
	default 800000000 if XTENSA_TIMER

config SYS_CLOCK_TICKS_PER_SEC
	default 50000

config DYNAMIC_INTERRUPTS
	default y

config LOG
	default n

endif # SOC_SERIES_NXP_IMX8ULP
```

## soc/xtensa/nxp_adsp/imx8ulp/Kconfig.soc
```kconfig
# Copyright (c) 2023 NXP
# SPDX-License-Identifier: Apache-2.0

choice
	prompt "NXP IMX8ULP ADSP SoC Selection"

	config SOC_NXP_IMX8ULP
		bool "NXP IMX8ULP"
		depends on SOC_SERIES_NXP_IMX8ULP
endchoice
```
